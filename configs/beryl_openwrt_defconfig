## configs/beryl_openwrt_defconfig
```kconfig
# GL-iNet Beryl (GL-MT1300, mipsel) under OpenWrt, installed as an .ipk.
# Router-class: real RAM, no MMU pressure, so the small envelope applies.
# Class 2 host — OpenWrt builds the engine as an external package with no
# shared Kconfig namespace; the host-guard catches what a preprocessor can.

CONFIG_WANTED_MAX_WAPPS=16
CONFIG_WANTED_WASM_STACK_SIZE=65536
CONFIG_WANTED_WASM_HEAP_SIZE=262144
CONFIG_WANTED_WASM_WORKER_STACK_SIZE=65536
CONFIG_WANTED_WASM_MAX_MEMORY_PAGES=16
CONFIG_WANTED_MAX_PATH_LEN=512
CONFIG_WANTED_MAX_DRIVERS_CNT=8
CONFIG_WANTED_MAX_OPTIONS_SIZE=256

CONFIG_WANTED_SUPERVISOR_WSH=y
CONFIG_WANTED_SUPERVISOR_IMAGE_PATH="/usr/share/wanted/supervisor.tar"
```

## configs/big_defconfig
```kconfig
# big resource envelope.
#
# Linux hosts and cloud. WASM_MAX_MEMORY_PAGES=0 lifts the per-wapp linear
# memory cap, which is only safe behind a real memory manager.
#
# Values are written out in full rather than minimised against the defaults,
# so a board's envelope is readable here without cross-referencing Kconfig.

CONFIG_WANTED_MAX_WAPPS=64
CONFIG_WANTED_WASM_STACK_SIZE=131072
CONFIG_WANTED_WASM_HEAP_SIZE=1048576
CONFIG_WANTED_WASM_WORKER_STACK_SIZE=131072
CONFIG_WANTED_WASM_MAX_MEMORY_PAGES=0
CONFIG_WANTED_MAX_PATH_LEN=4096
CONFIG_WANTED_MAX_DRIVERS_CNT=16
CONFIG_WANTED_MAX_OPTIONS_SIZE=1024
```

## configs/constrained_defconfig
```kconfig
# constrained resource envelope.
#
# The default envelope. Matches the Kconfig defaults, written out in full so
# a board file always states its numbers rather than inheriting them silently.
#
# Values are written out in full rather than minimised against the defaults,
# so a board's envelope is readable here without cross-referencing Kconfig.

CONFIG_WANTED_MAX_WAPPS=3
CONFIG_WANTED_WASM_STACK_SIZE=8192
CONFIG_WANTED_WASM_HEAP_SIZE=8192
CONFIG_WANTED_WASM_WORKER_STACK_SIZE=65536
CONFIG_WANTED_WASM_MAX_MEMORY_PAGES=1
CONFIG_WANTED_MAX_PATH_LEN=256
CONFIG_WANTED_MAX_DRIVERS_CNT=6
CONFIG_WANTED_MAX_OPTIONS_SIZE=128
```

## configs/esp32-nuttx_defconfig
```kconfig
# Classic ESP32 (Waveshare ESP32 One) under NuttX.
#
# Worker stacks must live in internal DRAM (reachable while the cache is off for
# flash ops/ISRs), which is scarce once WiFi and the PSRAM-backed engine are
# resident. 24 KiB fits two stacks alongside the WiFi buffers; 32 KiB fits one,
# and the 64 KiB default does not allocate at all. The classic interpreter keeps
# the wasm operand stack separate.
#

CONFIG_WANTED_MAX_WAPPS=3
CONFIG_WANTED_WASM_STACK_SIZE=8192
CONFIG_WANTED_WASM_HEAP_SIZE=8192
CONFIG_WANTED_WASM_WORKER_STACK_SIZE=24576
CONFIG_WANTED_WASM_MAX_MEMORY_PAGES=1
CONFIG_WANTED_MAX_PATH_LEN=256
CONFIG_WANTED_MAX_DRIVERS_CNT=6
CONFIG_WANTED_MAX_OPTIONS_SIZE=128
```

## configs/openwrt_defconfig
```kconfig
# Router-class: real RAM, no MMU pressure, so the small envelope applies.

CONFIG_WANTED_MAX_WAPPS=16
CONFIG_WANTED_WASM_STACK_SIZE=65536
CONFIG_WANTED_WASM_HEAP_SIZE=262144
CONFIG_WANTED_WASM_WORKER_STACK_SIZE=65536
CONFIG_WANTED_WASM_MAX_MEMORY_PAGES=16
CONFIG_WANTED_MAX_PATH_LEN=512
CONFIG_WANTED_MAX_DRIVERS_CNT=8
CONFIG_WANTED_MAX_OPTIONS_SIZE=256

# The packaging script pins the image path to where the .ipk installs it.
CONFIG_WANTED_SUPERVISOR_IMAGE_PATH="/usr/share/wanted/supervisor.tar"
CONFIG_WANTED_DEFAULT_CONFIG="configs/openwrt.json"
```

## configs/pimoroni_pico2_plus_w_defconfig
```kconfig
# Pimoroni Pico 2 Plus W under NuttX, RP2350 + PSRAM. Limits as `small`, as on
# the Feather; the board is here for the launch config.
#
# Matches pimoroni-pico-2-plus-w:sheriff — that config selects the sheriff boot
# ROMFS and the CYW43439, so the manager uplink is TCP rather than USB-CDC.

CONFIG_WANTED_MAX_WAPPS=16
CONFIG_WANTED_WASM_STACK_SIZE=65536
CONFIG_WANTED_WASM_HEAP_SIZE=262144
CONFIG_WANTED_WASM_WORKER_STACK_SIZE=65536
CONFIG_WANTED_WASM_MAX_MEMORY_PAGES=16
CONFIG_WANTED_MAX_PATH_LEN=512
CONFIG_WANTED_MAX_DRIVERS_CNT=8
CONFIG_WANTED_MAX_OPTIONS_SIZE=256

CONFIG_WANTED_SUPERVISOR_SHERIFF=y
CONFIG_WANTED_DEFAULT_CONFIG="configs/bringup-rp2350-wifi.json"
```

## configs/psram-s3_defconfig
```kconfig
# psram-s3 resource envelope.
#
# ESP32-S3 with octal PSRAM. The host-managed WASM heap is off (0): the
# fragmented PSRAM allocator serves the runtime better than a fixed pool.
#
# Values are written out in full rather than minimised against the defaults,
# so a board's envelope is readable here without cross-referencing Kconfig.

CONFIG_WANTED_MAX_WAPPS=20
CONFIG_WANTED_WASM_STACK_SIZE=65536
CONFIG_WANTED_WASM_HEAP_SIZE=0
CONFIG_WANTED_WASM_WORKER_STACK_SIZE=65536
CONFIG_WANTED_WASM_MAX_MEMORY_PAGES=16
CONFIG_WANTED_MAX_PATH_LEN=256
CONFIG_WANTED_MAX_DRIVERS_CNT=6
CONFIG_WANTED_MAX_OPTIONS_SIZE=128
```

## configs/rp2350_feather_defconfig
```kconfig
# Adafruit Feather RP2350 under NuttX, 8 MB PSRAM. PSRAM backs the large
# allocations, but worker stacks and wapp slot tables still come out of internal
# SRAM, which is what bounds the wapp count.
#
# The limits are `small`; the board is here for what an envelope cannot say —
# which launch config it ships. wsh, matching the board's NuttX config
# (adafruit-feather-rp2350:wanted selects no sheriff boot ROMFS). No imagePath
# in the config: the image comes from the boot ROMFS the app was built with.

CONFIG_WANTED_MAX_WAPPS=16
CONFIG_WANTED_WASM_STACK_SIZE=65536
CONFIG_WANTED_WASM_HEAP_SIZE=262144
CONFIG_WANTED_WASM_WORKER_STACK_SIZE=65536
CONFIG_WANTED_WASM_MAX_MEMORY_PAGES=16
CONFIG_WANTED_MAX_PATH_LEN=512
CONFIG_WANTED_MAX_DRIVERS_CNT=8
CONFIG_WANTED_MAX_OPTIONS_SIZE=256

CONFIG_WANTED_SUPERVISOR_WSH=y
CONFIG_WANTED_DEFAULT_CONFIG="configs/bringup-rp2350-wsh.json"
```

## configs/small_defconfig
```kconfig
# small resource envelope.
#
# Router-class and small-SBC targets with real RAM but no MMU pressure.
#

CONFIG_WANTED_MAX_WAPPS=16
CONFIG_WANTED_WASM_STACK_SIZE=65536
CONFIG_WANTED_WASM_HEAP_SIZE=262144
CONFIG_WANTED_WASM_WORKER_STACK_SIZE=65536
CONFIG_WANTED_WASM_MAX_MEMORY_PAGES=16
CONFIG_WANTED_MAX_PATH_LEN=512
CONFIG_WANTED_MAX_DRIVERS_CNT=8
CONFIG_WANTED_MAX_OPTIONS_SIZE=256
```

## configs/tiny_defconfig
```kconfig
# tiny resource envelope.
#
# Smallest envelope the engine runs in: ~512 KiB-class parts. Two wapp
# slots means a supervisor plus exactly one child.
#

CONFIG_WANTED_MAX_WAPPS=2
CONFIG_WANTED_WASM_STACK_SIZE=4096
CONFIG_WANTED_WASM_HEAP_SIZE=4096
CONFIG_WANTED_WASM_WORKER_STACK_SIZE=16384
CONFIG_WANTED_WASM_MAX_MEMORY_PAGES=1
CONFIG_WANTED_MAX_PATH_LEN=128
CONFIG_WANTED_MAX_DRIVERS_CNT=4
CONFIG_WANTED_MAX_OPTIONS_SIZE=64
```

## configs/xiao_esp32s3-storage_defconfig
```kconfig
# XIAO ESP32-S3 (ESP-IDF, octal PSRAM) — storage-biased. Trades wapp slots
# for a roomier persist partition. The host-managed WASM heap is off — the
# fragmented PSRAM allocator serves the runtime better than a fixed pool.
#
# Linear memory is capped at 2 pages (128 KiB) per wapp so a full house fits
# the 8 MB PSRAM: 10 slots x ~289 KiB is ~2.8 MB. The cap is deliberately
# below the arithmetic ceiling (10 pages) because `make sizes` excludes the
# per-image writable module copy — one .wasm per running wapp, out of the
# same PSRAM — and the image cache. A wapp needing more linear memory is
# refused at load, which is the intended loud failure.

CONFIG_WANTED_MAX_WAPPS=10
CONFIG_WANTED_WASM_STACK_SIZE=65536
CONFIG_WANTED_WASM_HEAP_SIZE=0
CONFIG_WANTED_WASM_WORKER_STACK_SIZE=65536
CONFIG_WANTED_WASM_MAX_MEMORY_PAGES=2
CONFIG_WANTED_MAX_PATH_LEN=256
CONFIG_WANTED_MAX_DRIVERS_CNT=6
CONFIG_WANTED_MAX_OPTIONS_SIZE=128
```

## configs/xiao_esp32s3_defconfig
```kconfig
# XIAO ESP32-S3 (ESP-IDF, octal PSRAM). The host-managed WASM heap is off —
# the fragmented PSRAM allocator serves the runtime better than a fixed pool.
#
# Linear memory is capped at 2 pages (128 KiB) per wapp so a full house fits
# the 8 MB PSRAM: 20 slots x ~289 KiB is ~5.7 MB. The cap is deliberately
# below the arithmetic ceiling (3 pages) because `make sizes` excludes the
# per-image writable module copy — one .wasm per running wapp, out of the
# same PSRAM — and the image cache. A wapp needing more linear memory is
# refused at load, which is the intended loud failure.

CONFIG_WANTED_MAX_WAPPS=20
CONFIG_WANTED_WASM_STACK_SIZE=65536
CONFIG_WANTED_WASM_HEAP_SIZE=0
CONFIG_WANTED_WASM_WORKER_STACK_SIZE=65536
CONFIG_WANTED_WASM_MAX_MEMORY_PAGES=2
CONFIG_WANTED_MAX_PATH_LEN=256
CONFIG_WANTED_MAX_DRIVERS_CNT=6
CONFIG_WANTED_MAX_OPTIONS_SIZE=128

# wsh is what this board's firmware has always embedded; the bring-up config
# grants it the ota driver, a log mount and reachability sockets.
CONFIG_WANTED_SUPERVISOR_WSH=y
CONFIG_WANTED_DEFAULT_CONFIG="configs/bringup-esp32s3.json"
```

## platform/esp-idf/m0-coexistence/sdkconfig.defaults
```kconfig
# Common defaults for both coexistence variants (ESP32-S3R8, octal PSRAM).
CONFIG_IDF_TARGET="esp32s3"

# 8 MB quad flash (GigaDevice on the XIAO ESP32-S3).
CONFIG_ESPTOOLPY_FLASHSIZE_8MB=y

# Custom partition table with the raw `pattern` data partition.
CONFIG_PARTITION_TABLE_CUSTOM=y
CONFIG_PARTITION_TABLE_CUSTOM_FILENAME="partitions.csv"

# Octal PSRAM at 80 MHz, exposed to heap_caps.
CONFIG_SPIRAM=y
CONFIG_SPIRAM_MODE_OCT=y
CONFIG_SPIRAM_SPEED_80M=y
CONFIG_SPIRAM_USE_MALLOC=y

# This board's console is USB-Serial/JTAG (/dev/ttyACM0).
CONFIG_ESP_CONSOLE_USB_SERIAL_JTAG=y

# The reproducer intentionally spins both cores flat-out; the task watchdog
# would otherwise trip on the starved idle tasks.
CONFIG_ESP_TASK_WDT_INIT=n
```

## platform/esp-idf/m0-coexistence/sdkconfig.defaults.baseline
```kconfig
# Baseline: coexistence mitigations OFF (ESP-IDF defaults, stated explicitly).
# The cache is disabled during each SPI1 flash operation — the coherency window
# is open. Establishes whether the workload triggers corruption on this silicon.
CONFIG_SPIRAM_FETCH_INSTRUCTIONS=n
CONFIG_SPIRAM_RODATA=n
# CONFIG_SPIRAM_XIP_FROM_PSRAM is not set
# CONFIG_SPI_FLASH_AUTO_SUSPEND is not set
```

## platform/esp-idf/m0-coexistence/sdkconfig.defaults.mitigated
```kconfig
# Mitigated: coexistence mitigations ON. Both are required for ESP-IDF to keep
# the cache enabled during an SPI1 flash operation.
CONFIG_SPIRAM_XIP_FROM_PSRAM=y
CONFIG_SPI_FLASH_AUTO_SUSPEND=y
```

## platform/esp-idf/m3pre-psram-stacks/sdkconfig.defaults
```kconfig
# Common defaults for both PSRAM-stack variants (ESP32-S3R8, octal PSRAM).
CONFIG_IDF_TARGET="esp32s3"

# 8 MB quad flash (GigaDevice on the XIAO ESP32-S3).
CONFIG_ESPTOOLPY_FLASHSIZE_8MB=y

# Custom partition table with the raw `pattern` data partition.
CONFIG_PARTITION_TABLE_CUSTOM=y
CONFIG_PARTITION_TABLE_CUSTOM_FILENAME="partitions.csv"

# Octal PSRAM at 80 MHz, exposed to heap_caps.
CONFIG_SPIRAM=y
CONFIG_SPIRAM_MODE_OCT=y
CONFIG_SPIRAM_SPEED_80M=y
CONFIG_SPIRAM_USE_MALLOC=y

# The point of the experiment: allow a task stack to live in PSRAM. Default y on
# the S3; stated explicitly so the build is self-documenting.
CONFIG_SPIRAM_ALLOW_STACK_EXTERNAL_MEMORY=y

# This board's console is USB-Serial/JTAG (/dev/ttyACM0).
CONFIG_ESP_CONSOLE_USB_SERIAL_JTAG=y

# Workers and the flash thrasher run both cores hot; the task watchdog would
# otherwise trip on the starved idle tasks.
CONFIG_ESP_TASK_WDT_INIT=n
```

## platform/esp-idf/m3pre-psram-stacks/sdkconfig.defaults.baseline
```kconfig
# Baseline: coexistence mitigations OFF (ESP-IDF defaults, stated explicitly).
# The cache is disabled during each SPI1 flash erase/program; the other CPU is
# stalled into IRAM for the window. Establishes whether PSRAM-resident task
# stacks survive that window without the S3 mitigations.
CONFIG_SPIRAM_FETCH_INSTRUCTIONS=n
CONFIG_SPIRAM_RODATA=n
# CONFIG_SPIRAM_XIP_FROM_PSRAM is not set
# CONFIG_SPI_FLASH_AUTO_SUSPEND is not set
```

## platform/esp-idf/m3pre-psram-stacks/sdkconfig.defaults.mitigated
```kconfig
# Mitigated: coexistence mitigations ON — the production ESP-IDF config. Both
# keep the cache enabled during an SPI1 flash operation, so a PSRAM-stacked task
# on the other core keeps running instead of being stalled.
CONFIG_SPIRAM_XIP_FROM_PSRAM=y
CONFIG_SPI_FLASH_AUTO_SUSPEND=y
```

## platform/esp-idf/sdkconfig.defaults
```kconfig
# Increased stack size
CONFIG_ESP_MAIN_TASK_STACK_SIZE=65536

# Disable task watchdog
CONFIG_ESP_TASK_WDT_INIT=n

# Increase CPU frequency
CONFIG_ESP_DEFAULT_CPU_FREQ_MHZ_240=y

# Set flash size
CONFIG_ESPTOOLPY_FLASHSIZE_4MB=y
CONFIG_ESPTOOLPY_FLASHSIZE="4MB"

# PSRAM support
CONFIG_SPIRAM=y
CONFIG_SPIRAM_IGNORE_NOTFOUND=y
CONFIG_SPIRAM_USE_MALLOC=y

# Set custom partition table file
CONFIG_PARTITION_TABLE_CUSTOM=y
CONFIG_PARTITION_TABLE_CUSTOM_FILENAME="partition_table.csv"
CONFIG_PARTITION_TABLE_FILENAME="partition_table.csv"
```
